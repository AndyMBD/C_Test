/****************************************************************************
** File : LIN_LDF.ldf
** Description : LIN Description file for the defined LIN cluster
*****************************************************************************/

LIN_description_file;
LIN_protocol_version = "2.1";
LIN_language_version = "2.1";
LIN_speed = 19.2 kbps;
Channel_name = "LIN_Configuration1";

Nodes {
    Master: LINMaster, 5 ms, 0.1 ms;
    Slaves: Motor;
}

Signals {
    RefSpeed: 16,0,LINMaster,Motor;
    ActSpeed: 16,0,Motor,LINMaster;
    Error: 1,0,Motor,LINMaster;
}

Frames {
    MotorCtrl:17,LINMaster,8{
        RefSpeed,0;
    }
    MotorStatus:18,Motor,8{
        ActSpeed,0;
        Error,16;
    }
}

Sporadic_frames {
}

Event_triggered_frames {
}

Node_attributes {
    Motor {
        LIN_protocol = 2.1;
        configured_NAD = 1;
        initial_NAD = 1;
        product_id = 4660,22136,0;
        response_error = Error;
        /*fault_state_signals: not configured in GUI*/
        P2_min = 50 ms;
        ST_min = 0 ms;
        N_As_timeout = 1000 ms;
        N_Cr_timeout = 1000 ms;
        configurable_frames {
                 MotorCtrl;
                 MotorStatus;
        }
    }
}

Schedule_tables {
    Run {
        MotorCtrl delay 100 ms;
        MotorStatus delay 100 ms;
    }
}
